## configs/rpi_2_defconfig
```kconfig
CONFIG_ARM=y
CONFIG_ARCH_BCM283X=y
CONFIG_TARGET_RPI_2=y
CONFIG_OF_BOARD_SETUP=y
CONFIG_HUSH_PARSER=y
CONFIG_SYS_PROMPT="U-Boot> "
CONFIG_CMD_BOOTZ=y
# CONFIG_CMD_IMLS is not set
# CONFIG_CMD_FLASH is not set
CONFIG_CMD_MMC=y
CONFIG_CMD_USB=y
# CONFIG_CMD_FPGA is not set
CONFIG_CMD_GPIO=y
CONFIG_CMD_DHCP=y
CONFIG_CMD_MII=y
CONFIG_CMD_PING=y
CONFIG_CMD_EXT2=y
CONFIG_CMD_EXT4=y
CONFIG_CMD_FAT=y
CONFIG_CMD_FS_GENERIC=y
CONFIG_PHYS_TO_BUS=y
CONFIG_OF_LIBFDT=y
CONFIG_DM_I2C=y
CONFIG_CMD_I2C=y
CONFIG_CMD_TPM=y
CONFIG_TPM_TIS_INFINEON=y
CONFIG_TPM=y
CONFIG_OF_CONTROL=y
CONFIG_OF_SEPARATE=y
CONFIG_LZO=y
CONFIG_RSA=y
CONFIG_FSA=y
CONFIG_FIT=y
CONFIG_FIT_SIGNATURE=y
CONFIG_SBOOT=y
```
